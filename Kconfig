## Kconfig
```kconfig
menu "LiNEA40 custom features"

config ZMK_INPUT_PROCESSOR_DIRECTIONAL_GESTURES
    bool "Directional gestures input processor"
    default y
    depends on ZMK_POINTING

endmenu
```

## dts/bindings/input_processors/zmk,input-processor-directional-gestures.yaml
```yaml
# Copyright (c) 2026
# SPDX-License-Identifier: MIT

description: Input Processor for invoking behaviors from relative X/Y direction gestures

compatible: "zmk,input-processor-directional-gestures"

include: ip_one_param.yaml

properties:
  type:
    type: int
  x-code:
    type: int
    required: true
  y-code:
    type: int
    required: true
  cooldown-ms:
    type: int
    default: 250
  bindings:
    type: phandle-array
    required: true
```
